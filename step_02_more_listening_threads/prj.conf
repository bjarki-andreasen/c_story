## prj.conf
```kconfig
CONFIG_EVENTS=y
```

## src/bar.c
```c
#include <c_story/bar.h>
#include <c_story/foo.h>
#include <c_story/baz.h>
#include <zephyr/kernel.h>

static struct bar bar;

static struct k_spinlock b_lock;
static struct k_spinlock l_lock;
static sys_slist_t listener_list;

void bar_get_bar(struct bar *b)
{
	K_SPINLOCK(&b_lock) {
		*b = bar;
	}
}

void bar_add_callback(struct bar_listener *listener, bar_callback cb)
{
	listener->cb = cb;
	sys_slist_append(&listener_list, &listener->node);
}

static void bar_set_bar(const struct bar *b)
{
	sys_snode_t *node;
	struct bar_listener *listener;
	bar_callback cb;

	K_SPINLOCK(&b_lock) {
		bar = *b;
	}

	K_SPINLOCK(&l_lock) {
		SYS_SLIST_FOR_EACH_NODE(&listener_list, node) {
			listener = CONTAINER_OF(node, struct bar_listener, node);
			cb = listener->cb;
			cb();
		}
	}
}

static void bar_routine(void)
{
	static struct bar bar_set;

	while (true) {
		bar_set.b++;
		printk("bar set bar.b to %u\n", bar_set.b);
		bar_set_bar(&bar_set);
		k_msleep(1000);
	}
}

K_THREAD_DEFINE(bar_thread, 512, bar_routine, NULL, NULL, NULL, 3, 0, 0);
```

## src/baz.c
```c
#include <c_story/baz.h>
#include <c_story/bar.h>
#include <c_story/foo.h>
#include <zephyr/kernel.h>

static struct baz baz = {
	.b = 20,
	.a = 30,
	.z = 40,
};

static struct k_spinlock lock;
static struct k_sem bar_set_sem;

void baz_get_baz(struct baz *b)
{
	K_SPINLOCK(&lock) {
		*b = baz;
	}
}

static void baz_set_baz(const struct baz *b)
{
	K_SPINLOCK(&lock) {
		baz = *b;
	}
}

static void on_bar_set(void)
{
	k_sem_give(&bar_set_sem);
}

static void baz_routine(void)
{
	static struct bar bar_get_last;
	static struct bar bar_get;
	static struct baz baz_set;
	static struct bar_listener bar_listener;

	bar_get_bar(&bar_get_last);
	k_sem_init(&bar_set_sem, 0, 1);
	bar_add_callback(&bar_listener, on_bar_set);

	while (true) {
		k_sem_take(&bar_set_sem, K_FOREVER);
		bar_get_bar(&bar_get);
		if (bar_get.b != bar_get_last.b) {
			printk("baz detected bar.b change from %u to %u\n", bar_get_last.b, bar_get.b);
			printk("baz set baz.b to %u\n", bar_get.b);
			baz_set.b = bar_get.b;
			baz_set_baz(&baz_set);
		}
	}
}

K_THREAD_DEFINE(baz_thread, 512, baz_routine, NULL, NULL, NULL, 3, 0, 0);
```

## src/qic.c
```c
#include <c_story/qic.h>
#include <c_story/foo.h>
#include <c_story/baz.h>
#include <zephyr/kernel.h>

static struct qic qic;

static struct k_spinlock b_lock;
static struct k_spinlock l_lock;
static sys_slist_t listener_list;

void qic_get_qic(struct qic *b)
{
	K_SPINLOCK(&b_lock) {
		*b = qic;
	}
}

void qic_add_callback(struct qic_listener *listener, qic_callback cb)
{
	listener->cb = cb;
	sys_slist_append(&listener_list, &listener->node);
}

static void qic_set_qic(const struct qic *b)
{
	sys_snode_t *node;
	struct qic_listener *listener;
	qic_callback cb;

	K_SPINLOCK(&b_lock) {
		qic = *b;
	}

	K_SPINLOCK(&l_lock) {
		SYS_SLIST_FOR_EACH_NODE(&listener_list, node) {
			listener = CONTAINER_OF(node, struct qic_listener, node);
			cb = listener->cb;
			cb();
		}
	}
}

static void qic_routine(void)
{
	static struct qic qic_set;

	while (true) {
		qic_set.q++;
		printk("qic set qic.b to %u\n", qic_set.q);
		qic_set_qic(&qic_set);
		k_msleep(500);
	}
}

K_THREAD_DEFINE(qic_thread, 512, qic_routine, NULL, NULL, NULL, 3, 0, 0);
```
